# file: IntroductionToC3.ioc
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Mcu.Family=STM32G0
Mcu.Name=STM32G071R(6-8-B)Tx
Mcu.Package=LQFP64
PA13.Mode=Serial_Wire
PA13.Signal=SYS_SWDIO
PA14-BOOT0.Mode=Serial_Wire
PA14-BOOT0.Signal=SYS_SWCLK
ProjectManager.HeapSize=0x200
ProjectManager.StackSize=0x400
ProjectManager.TargetToolchain=STM32CubeIDE
RCC.AHBFreq_Value=16000000
RCC.CortexFreq_Value=16000000
RCC.EXTERNAL_CLOCK_VALUE=48000
RCC.HCLKFreq_Value=16000000
RCC.HSE_VALUE=8000000
RCC.HSI_VALUE=16000000
RCC.LSE_VALUE=32768
RCC.SYSCLKFreq_VALUE=16000000
RCC.VCOOutputFreq_Value=128000000
board=custom

// file: Core/Src/main.c
/* USER CODE BEGIN Header */
/**
  ******************************************************************************
  * @file           : main.c
  * @brief          : Main program body
  ******************************************************************************
  * @attention
  *
  * Copyright (c) 2024 STMicroelectronics.
  * All rights reserved.
  *
  * This software is licensed under terms that can be found in the LICENSE file
  * in the root directory of this software component.
  * If no LICENSE file comes with this software, it is provided AS-IS.
  *
  ******************************************************************************
  */
/* USER CODE END Header */

#include "main.h"

void SystemClock_Config(void);
static void MX_GPIO_Init(void);

#define PORTA_BASE_ADDR 0x50000000 // Port A 베이스 주소 정의
#define Grn_LED_Pin 5
#define LOOP_DELAY 800000

int main(void)
{

  /* USER CODE BEGIN 1 */

//	//그린 LED와 연결된 포트와 연관된 비트를 위한 마스크 정의
	uint32_t GrnLEDMask32Bit1 = ((uint32_t)(0X0001 << (2*Grn_LED_Pin+1)));
	uint32_t GrnLEDMask32Bit0 = ((uint32_t)(0X0001 << 2*Grn_LED_Pin));
	uint32_t GrnLEDMask16Bit = ((uint16_t)(0X0001 << Grn_LED_Pin));
	__HAL_RCC_GPIOA_CLK_ENABLE();
  /* USER CODE END 1 */

  /* MCU Configuration--------------------------------------------------------*/

  /* Reset of all peripherals, Initializes the Flash interface and the Systick. */
  HAL_Init();

  /* Configure the system clock */
  SystemClock_Config();

  /* Initialize all configured peripherals */
  MX_GPIO_Init();
  /* USER CODE BEGIN 2 */

  GPIOA ->MODER &=~(GrnLEDMask32Bit1 | GrnLEDMask32Bit0);
  GPIOA ->MODER|= GrnLEDMask32Bit0;

  GPIOA ->OTYPER &= ~GrnLEDMask16Bit;

  GPIOA ->OSPEEDR&= ~(GrnLEDMask32Bit1 | GrnLEDMask32Bit0);

  GPIOA ->PUPDR&=~(GrnLEDMask32Bit1 |GrnLEDMask32Bit0);
  GPIOA ->BSRR &=~(uint32_t) (0x0001<<(Grn_LED_Pin +16));

  /* USER CODE END 2 */

  /* Infinite loop */
  while (1)
  {

//-------------------------------------
	  //모듈 1
      //GPIOA->BSRR = (GPIOA->ODR & (1 << Grn_LED_Pin)) ? (1 << (Grn_LED_Pin + 16)) : (1 << Grn_LED_Pin);
      //when led is on, make it turn off (adding 16 bit to make led value to low)turning off the corresponding GPIO pin, 거짓이면 turning in

	  //ToggleGreenLED();

	  ToggleGreenLEDUsingBSRR();
	  for(uint32_t i=0; i<LOOP_DELAY;i++);

    /* USER CODE BEGIN 3 */

//	  swap(&num1, &num2);
  }
  /* USER CODE END 3 */
}

void SystemClock_Config(void)
{
  RCC_OscInitTypeDef RCC_OscInitStruct = {0};
  RCC_ClkInitTypeDef RCC_ClkInitStruct = {0};

  /** Configure the main internal regulator output voltage
  */
  HAL_PWREx_ControlVoltageScaling(PWR_REGULATOR_VOLTAGE_SCALE1);

  /** Initializes the RCC Oscillators according to the specified parameters
  * in the RCC_OscInitTypeDef structure.
  */
  RCC_OscInitStruct.OscillatorType = RCC_OSCILLATORTYPE_HSI;
  RCC_OscInitStruct.HSIState = RCC_HSI_ON;
  RCC_OscInitStruct.HSIDiv = RCC_HSI_DIV1;
  RCC_OscInitStruct.HSICalibrationValue = RCC_HSICALIBRATION_DEFAULT;
  RCC_OscInitStruct.PLL.PLLState = RCC_PLL_NONE;
  if (HAL_RCC_OscConfig(&RCC_OscInitStruct) != HAL_OK)
  {
    Error_Handler();
  }

  /** Initializes the CPU, AHB and APB buses clocks
  */
  RCC_ClkInitStruct.ClockType = RCC_CLOCKTYPE_HCLK|RCC_CLOCKTYPE_SYSCLK
                              |RCC_CLOCKTYPE_PCLK1;
  RCC_ClkInitStruct.SYSCLKSource = RCC_SYSCLKSOURCE_HSI;
  RCC_ClkInitStruct.AHBCLKDivider = RCC_SYSCLK_DIV1;
  RCC_ClkInitStruct.APB1CLKDivider = RCC_HCLK_DIV1;

  if (HAL_RCC_ClockConfig(&RCC_ClkInitStruct, FLASH_LATENCY_0) != HAL_OK)
  {
    Error_Handler();
  }
}

static void MX_GPIO_Init(void)
{

  /* GPIO Ports Clock Enable */
  __HAL_RCC_GPIOA_CLK_ENABLE();

}

void Error_Handler(void)
{
  __disable_irq();
  while (1)
  {
  }
}
